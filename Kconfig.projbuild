## Kconfig.projbuild
```kconfig
menu "WiFi Config"

    config WIFI_CFG_MAX_NETWORKS
        int "Maximum saved networks"
        default 5
        help
            Maximum number of WiFi networks that can be saved in NVS.

    config WIFI_CFG_MAX_VARS
        int "Maximum custom variables"
        default 10
        help
            Maximum number of custom variables that can be saved.

    config WIFI_CFG_DEFAULT_RETRY
        int "Default retry per network"
        default 3
        help
            Number of connection retries per network before trying the next one.

    config WIFI_CFG_RETRY_INTERVAL_MS
        int "Retry interval (ms)"
        default 5000
        help
            Interval between connection retries in milliseconds.

    config WIFI_CFG_MAX_SCAN_RESULTS
        int "Maximum scan results returned"
        default 20
        help
            Maximum number of WiFi scan results returned by the scan API.

    config WIFI_CFG_HTTP_MAX_CONTENT_LEN
        int "HTTP max request body size"
        default 2048
        help
            Maximum allowed size (bytes) for HTTP request bodies (JSON payloads).

    config WIFI_CFG_TASK_STACK_SIZE
        int "Manager task stack size"
        default 4096
        help
            Stack size (bytes) for the WiFi Config FreeRTOS task.

    config WIFI_CFG_TASK_PRIORITY
        int "Manager task priority"
        default 5
        help
            FreeRTOS priority for the WiFi Config task and DNS server task.

    config WIFI_CFG_HTTP_MAX_URI_HANDLERS
        int "Max HTTP URI handlers"
        default 32
        help
            Maximum number of URI handlers registered with the HTTP server.
            Default accounts for API(18) + WebUI(3) + Captive(8) + reserve.

    config WIFI_CFG_ENABLE_CLI
        bool "Enable CLI interface"
        default n
        help
            Enable command-line interface for WiFi Config.
            Requires ESP Console component.

            Commands: wifi_status, wifi_scan, wifi_list, wifi_add,
            wifi_del, wifi_connect, wifi_disconnect, wifi_ap_start,
            wifi_ap_stop, wifi_reset, wifi_var_get, wifi_var_set

    config WIFI_CFG_ENABLE_SOFTAP
        bool "Enable SoftAP provisioning portal"
        default y
        help
            Build the SoftAP provisioning portal: the access point, the
            HTTP server and its REST API, the eight captive-portal
            handlers and the captive DNS responder.

            Default y, which is the historical behaviour -- these files
            were unconditional before this option existed, and the only
            way to suppress them was at runtime (cfg.enable_ap = false),
            which stops them running but still links them.

            Set to n only if the device is provisioned exclusively over
            Improv Serial, Improv BLE or Network Provisioning BLE. The
            saving is substantial (roughly 20-28 KB of flash depending
            on which transport remains) because it also drops cJSON and
            newlib's floating-point string conversion when no other
            component uses them.

            With this off, wifi_cfg_start_ap(), wifi_cfg_stop_ap(),
            wifi_cfg_get_ap_status(), wifi_cfg_set_ap_config(),
            wifi_cfg_get_ap_config() and wifi_cfg_stop_http() still
            exist and return ESP_ERR_NOT_SUPPORTED, so application code
            keeps compiling. cfg.enable_ap is ignored.

    config WIFI_CFG_ENABLE_WEBUI
        bool "Enable Web UI"
        default n
        depends on WIFI_CFG_ENABLE_SOFTAP
        help
            Serve a Web UI at the root path (/) of the portal's HTTP
            server. Where the UI's files come from is selected by
            WIFI_CFG_WEBUI_SOURCE below: the library's bundled Preact
            UI (~16 KB gzipped, embedded in the firmware), files on a
            LittleFS/SPIFFS partition, or assets the application
            supplies at runtime through wifi_cfg_webui_set_asset_provider().

            Requires the SoftAP portal: the Web UI is served by the same
            HTTP server. With this off, / serves a minimal built-in
            page instead.

    choice WIFI_CFG_WEBUI_SOURCE
        prompt "Web UI asset source"
        depends on WIFI_CFG_ENABLE_WEBUI
        default WIFI_CFG_WEBUI_SOURCE_EMBEDDED
        help
            Exactly one source is compiled in. Whatever the source, an
            asset provider registered with
            wifi_cfg_webui_set_asset_provider() is consulted first; the
            selected source is what answers when no provider is
            registered or the provider declines the path.

        config WIFI_CFG_WEBUI_SOURCE_EMBEDDED
            bool "Library's bundled UI, embedded in firmware"
            help
                Link the library's own frontend (frontend/dist) into the
                firmware. No application code or filesystem needed.

        config WIFI_CFG_WEBUI_SOURCE_FILESYSTEM
            bool "Custom UI from LittleFS/SPIFFS"
            help
                Serve every GET for a non-API path from
                WIFI_CFG_WEBUI_CUSTOM_PATH on a mounted filesystem. The
                library's frontend is not linked in, so a missing file
                is a 404. Lets the UI be replaced without reflashing
                the firmware.

        config WIFI_CFG_WEBUI_SOURCE_APPLICATION
            bool "Custom UI supplied by the application"
            help
                The application embeds its own UI files (EMBED_FILES,
                board_build.embed_files, a generated header, ...) and
                registers wifi_cfg_webui_set_asset_provider() to hand
                them to the library on request. The library's frontend
                is not linked in and no filesystem is touched. Works
                the same under idf.py and PlatformIO.

    endchoice

    config WIFI_CFG_WEBUI_CUSTOM_PATH
        string "Custom Web UI path (filesystem)"
        default ""
        depends on WIFI_CFG_ENABLE_WEBUI
        help
            Mount point the Web UI files are served from when
            WIFI_CFG_WEBUI_SOURCE_FILESYSTEM is selected.
            Example: "/littlefs" or "/spiffs"

            Only meaningful with the filesystem source. It is left
            visible in the other modes so a build can flag a stale
            value: before WIFI_CFG_WEBUI_SOURCE existed, a non-empty
            path was what selected the filesystem mode.

    menu "Network Provisioning (BLE)"

        config WIFI_CFG_ENABLE_NETWORK_PROVISIONING
            bool "Enable ESP-IDF Network/Wi-Fi Provisioning"
            default n
            depends on BT_ENABLED && (BT_BLUEDROID_ENABLED || BT_NIMBLE_ENABLED)
            select BT_NIMBLE_ROLE_PERIPHERAL if BT_NIMBLE_ENABLED
            select BT_NIMBLE_ROLE_BROADCASTER if BT_NIMBLE_ENABLED
            select BT_NIMBLE_GATT_SERVER if BT_NIMBLE_ENABLED
            help
                Enable provisioning via the official ESP-IDF wifi_provisioning
                manager. The library wraps wifi_prov_mgr with the BLE scheme,
                handles credential storage in the multi-network store, and
                exposes a small set of custom protocomm endpoints for
                version/capabilities/variables.

                On ESP-IDF 5.4 this uses the in-tree wifi_provisioning
                component. On ESP-IDF 6.x the implementation is expected to
                migrate to the external `espressif/network_provisioning`
                managed component (see migration notes in MIGRATION.md).

                This replaces the previous custom JSON-over-GATT BLE
                interface (UUID 0xFFE0), which has been removed in this
                release. See the migration guide for instructions on moving
                client tools to the new BLE provisioning protocol.

        config WIFI_CFG_NETWORK_PROVISIONING_BLE
            bool "Use BLE transport (wifi_prov_scheme_ble)"
            default y
            depends on WIFI_CFG_ENABLE_NETWORK_PROVISIONING
            help
                Use the BLE transport scheme for the wifi_provisioning manager.
                Currently the only transport supported by this library; SoftAP
                provisioning is provided separately by the existing captive
                portal flow.

                Running both at once works, but only because this library puts
                the SoftAP back: wifi_prov_mgr_start_provisioning() forces
                WIFI_MODE_STA and takes any running SoftAP with it, and the
                manager has no way to know one was meant to stay up. If you see
                "SoftAP was taken down by ..." at warning level, that is the
                reconciliation working, not a fault.

    endmenu

    menu "Improv WiFi"

        config WIFI_CFG_ENABLE_IMPROV_BLE
            bool "Enable Improv BLE transport"
            default n
            depends on BT_ENABLED && (BT_BLUEDROID_ENABLED || BT_NIMBLE_ENABLED)
            depends on !WIFI_CFG_ENABLE_NETWORK_PROVISIONING
            select BT_NIMBLE_ROLE_PERIPHERAL if BT_NIMBLE_ENABLED
            select BT_NIMBLE_ROLE_BROADCASTER if BT_NIMBLE_ENABLED
            select BT_NIMBLE_GATT_SERVER if BT_NIMBLE_ENABLED
            help
                Enable the Improv WiFi BLE transport. Registers a GATT service
                (UUID 00467768-...) for provisioning via Web Bluetooth or the
                ESPHome companion app.
                Reference: https://www.improv-wifi.com/

                Mutually exclusive with WIFI_CFG_ENABLE_NETWORK_PROVISIONING:
                only one BLE provisioning protocol can own the BLE host /
                advertising at a time. Pick the one that matches your
                provisioning client tooling.

        config WIFI_CFG_ENABLE_IMPROV_SERIAL
            bool "Enable Improv Serial transport"
            default n
            depends on !WIFI_CFG_ENABLE_CLI
            help
                Enable the Improv WiFi Serial transport over UART.
                Uses the Improv Serial framing protocol.
                Reference: https://www.improv-wifi.com/

                Independent of BLE — safe to enable alongside Network
                Provisioning BLE.

                Mutually exclusive with WIFI_CFG_ENABLE_CLI: both want to
                own the console UART (the CLI prints human-readable
                output via esp_console while Improv Serial frames binary
                bytes on the same stream), so only one can be active.

        config WIFI_CFG_IMPROV_SERIAL_UART_NUM
            int "Improv Serial UART port number"
            default 0
            depends on WIFI_CFG_ENABLE_IMPROV_SERIAL
            help
                UART port number used for Improv Serial transport.
                0 = UART0, 1 = UART1, 2 = UART2.

        config WIFI_CFG_IMPROV_SERIAL_BAUD
            int "Improv Serial baud rate"
            default 115200
            depends on WIFI_CFG_ENABLE_IMPROV_SERIAL
            help
                Baud rate for the Improv Serial UART transport.

    endmenu

endmenu
```
